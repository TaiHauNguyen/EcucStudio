AUTOSAR XML (schema 00052)
standard types defined: uint8, uint16, uint32
package /Topology/Clusters
  can cluster Body_Cluster: baudrate=500000
    can physical channel Body: comm-connectors=CN_Body
      frame DoorStatus: id 0x200, to GwEcu, frame-length=2, can-addressing-mode=STANDARD, can-frame-rx-behavior=CAN-20, can-frame-tx-behavior=CAN-20
        pdu DoorStatus: length=2, transmission-mode-true-timing=cyclic-timing=time-period=0.1
          signal DoorOpen: start 0, 1 bit, little-endian, data-type-policy=OVERRIDE, init-value=0, base-type=uint8, transfer-property=PENDING
package /Topology/Ecus
  ecu instance GwEcu: com-configuration-gw-time-base=0.005, com-configuration-rx-time-base=0.005, com-configuration-tx-time-base=0.005, sleep-mode-supported=false, wake-up-over-bus-supported=false
    can communication controller CT_Body
    can communication connector CN_Body: comm-controller=CT_Body
package /System
  system GwSystem: category=ECU_EXTRACT
