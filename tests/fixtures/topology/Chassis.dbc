VERSION ""

NS_ :

BS_:

BU_: ZoneB Abs

BO_ 288 WheelSpeed: 8 Abs
 SG_ WheelFL : 0|16@1+ (1,0) [0|0] "" ZoneB
 SG_ WheelFR : 16|16@1+ (1,0) [0|0] "" ZoneB

BO_ 336 VehSpeed: 8 Abs
 SG_ Speed : 0|16@1+ (1,0) [0|0] "" ZoneB

BO_ 320 GearPos: 2 ZoneB
 SG_ Gear : 0|4@1+ (1,0) [0|0] "" Abs

BA_DEF_ "Baudrate" INT 0 1000000;
BA_DEF_ "DBName" STRING ;
BA_DEF_DEF_ "Baudrate" 500000;
BA_DEF_DEF_ "DBName" "";
BA_ "DBName" "Chassis";
