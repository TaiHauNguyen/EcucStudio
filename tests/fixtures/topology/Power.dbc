VERSION ""

NS_ :

BS_:

BU_: ZoneB Engine

BO_ 768 PowerState: 8 Engine
 SG_ Voltage : 0|16@1+ (1,0) [0|0] "" ZoneB
 SG_ Current : 16|16@1+ (1,0) [0|0] "" ZoneB

BO_ 544 DoorState: 2 ZoneB
 SG_ DoorOpen : 0|1@1+ (1,0) [0|0] "" Engine

BO_ 320 GearPos: 2 Engine
 SG_ Gear : 0|4@1+ (1,0) [0|0] "" ZoneB

BA_DEF_ "Baudrate" INT 0 1000000;
BA_DEF_ "DBName" STRING ;
BA_DEF_DEF_ "Baudrate" 500000;
BA_DEF_DEF_ "DBName" "";
BA_ "DBName" "Power";
