VERSION ""

NS_ :

BS_:

BU_: GwEcu Engine Brake Door

BO_ 256 EngineData: 8 Engine
 SG_ EngineSpeed : 0|16@1+ (0.25,0) [0|16383.75] "rpm" GwEcu
 SG_ EngineTemp : 16|8@1- (1,-40) [-40|87] "degC" GwEcu

BO_ 2147484416 BrakeStatus: 16 Brake
 SG_ BrakePressure : 7|16@0+ (0.1,0) [0|6553.5] "bar" GwEcu,Engine
 SG_ BrakeActive : 24|1@1+ (1,0) [0|1] "" GwEcu

BO_ 512 DoorStatus: 2 Door
 SG_ DoorOpen : 0|1@1+ (1,0) [0|1] "" GwEcu

BO_ 768 GwCommand: 4 GwEcu
 SG_ Cmd : 0|8@1+ (1,0) [0|255] "" Engine
 SG_ Counter : 8|4@1+ (1,0) [0|15] "" Engine

BO_ 1536 NmGwEcu: 8 GwEcu
 SG_ NmData : 0|64@1+ (1,0) [0|0] "" Engine

BO_ 2147483904 ExtSameId: 8 Brake
 SG_ ExtData : 0|32@1+ (1,0) [0|0] "" GwEcu

BA_DEF_ BO_ "GenMsgCycleTime" INT 0 10000;
BA_DEF_ BO_ "VFrameFormat" ENUM "StandardCAN","ExtendedCAN","reserved","reserved","reserved","reserved","reserved","reserved","reserved","reserved","reserved","reserved","reserved","reserved","StandardCAN_FD","ExtendedCAN_FD";
BA_DEF_ BO_ "NmAsrMessage" ENUM "No","Yes";
BA_DEF_ "Baudrate" INT 0 1000000;
BA_DEF_ "DBName" STRING ;
BA_DEF_DEF_ "GenMsgCycleTime" 0;
BA_DEF_DEF_ "VFrameFormat" "StandardCAN";
BA_DEF_DEF_ "NmAsrMessage" "No";
BA_DEF_DEF_ "Baudrate" 500000;
BA_DEF_DEF_ "DBName" "";
BA_ "DBName" "Body";
BA_ "GenMsgCycleTime" BO_ 256 10;
BA_ "GenMsgCycleTime" BO_ 2147484416 20;
BA_ "GenMsgCycleTime" BO_ 512 100;
BA_ "VFrameFormat" BO_ 2147484416 15;
BA_ "NmAsrMessage" BO_ 1536 1;
