AUTOSAR XML (schema 00052)
standard types defined: uint8, uint16, uint32
package /Topology/Clusters
  can cluster Body_Cluster: baudrate=500000
    can physical channel Body: comm-connectors=CN_Body
      frame DoorStatus: id 0x200, to GwEcu, frame-length=2, can-addressing-mode=STANDARD, can-frame-rx-behavior=CAN-20, can-frame-tx-behavior=CAN-20
        pdu DoorStatus: length=2, transmission-mode-true-timing=cyclic-timing=time-period=0.1
          signal DoorOpen: start 0, 1 bit, little-endian, data-type-policy=OVERRIDE, init-value=0, base-type=uint8, transfer-property=PENDING
  ethernet cluster EthCluster: baudrate=100000000
    ethernet physical channel Eth_VLAN10: category=WIRED, comm-connectors=GwEcu_Eth_VLAN10
      pdu triggering LampCmd_Eth_PT: pdu=LampCmd_Eth, from GwEcu
      network endpoint NEP_GwEcu: network-endpoint-addresses=ipv-4-configuration={ipv-4-address=10.0.10.1, ipv-4-address-source=FIXED, network-mask=255.255.255.0}
      network endpoint NEP_Tester: network-endpoint-addresses=ipv-4-configuration={ipv-4-address=10.0.10.2, ipv-4-address-source=FIXED, network-mask=255.255.255.0}
      so-ad-config:
        socket address SA_Tester_Rx
          application endpoint AEP_Tester_Rx: network-endpoint=NEP_Tester, tp-configuration=udp-tp=udp-tp-port=port-number=42000
        socket address SA_GwEcu_Tx: connector=GwEcu_Eth_VLAN10
          application endpoint AEP_GwEcu_Tx: network-endpoint=NEP_GwEcu, tp-configuration=udp-tp=udp-tp-port=port-number=42000
          static socket connection GwEcu_to_Tester: i-pdu-identifiers=LampCmd_Eth_ID, remote-addresss=SA_Tester_Rx
      vlan VLAN10: vlan-identifier=10
  socket connection ipdu identifier set VLAN10_Ids
    so con i pdu identifier LampCmd_Eth_ID: header-id=256, pdu-triggering=LampCmd_Eth_PT
package /Topology/Ecus
  ecu instance GwEcu: com-configuration-gw-time-base=0.005, com-configuration-rx-time-base=0.005, com-configuration-tx-time-base=0.005, sleep-mode-supported=false, wake-up-over-bus-supported=false
    can communication controller CT_Body
    ethernet communication controller GwEcu_EthCtrl: mac-unicast-address=02:00:00:00:00:01, maximum-receive-buffer-length=1522, maximum-transmit-buffer-length=1522
      coupling port GwEcu_EthPort: vlan-membership{default-priority=0, send-activity=SENT-TAGGED, vlan=Eth_VLAN10}
    can communication connector CN_Body: comm-controller=CT_Body
    ethernet communication connector GwEcu_Eth_VLAN10: comm-controller=GwEcu_EthCtrl, network-endpoint=NEP_GwEcu
package /Communication/PDUs
  pdu LampCmd_Eth: length=1, transmission-mode-true-timing=event-controlled-timing=number-of-repetitions=0
    signal LampCmd: start 0, 8 bit, data-type-policy=OVERRIDE, init-value=0, base-type=uint8, transfer-property=TRIGGERED
package /System
  system GwSystem: category=ECU_EXTRACT
